/*
 * Copyright (c) 2020 The ZMK Contributors
 *
 * SPDX-License-Identifier: MIT
 */

#include "anise60b.dtsi"

/ {
    /* This kscan is for the 60% left half without macro keys the
     * macro pad layout may require different column and row pins
     */
    kscan0: kscan {
        compatible = "zmk,kscan-gpio-matrix";
        label = "KSCAN";
        diode-direction = "col2row";


        col-gpios
            = <&anise_ctl 21 GPIO_ACTIVE_HIGH>
            , <&anise_ctl 22 GPIO_ACTIVE_HIGH>
            , <&anise_ctl 23 GPIO_ACTIVE_HIGH>
            , <&anise_ctl 24 GPIO_ACTIVE_HIGH>
            , <&anise_ctl 25 GPIO_ACTIVE_HIGH>
            , <&anise_ctl 26 GPIO_ACTIVE_HIGH>
            , <&anise_ctl 27 GPIO_ACTIVE_HIGH>
            ;

        row-gpios
            = <&anise_ctl 11 (GPIO_ACTIVE_HIGH | GPIO_PULL_DOWN)>
            , <&anise_ctl 12 (GPIO_ACTIVE_HIGH | GPIO_PULL_DOWN)>
            , <&anise_ctl 13 (GPIO_ACTIVE_HIGH | GPIO_PULL_DOWN)>
            , <&anise_ctl 14 (GPIO_ACTIVE_HIGH | GPIO_PULL_DOWN)>
            , <&anise_ctl 15 (GPIO_ACTIVE_HIGH | GPIO_PULL_DOWN)>
            ;

/*
 * for promicro interconnect
        col-gpios
            = <&pro_micro 0 GPIO_ACTIVE_HIGH>
            , <&pro_micro 16 GPIO_ACTIVE_HIGH>
            , <&pro_micro 1 GPIO_ACTIVE_HIGH>
            , <&pro_micro 14 GPIO_ACTIVE_HIGH>
            , <&pro_micro 5 GPIO_ACTIVE_HIGH>
            , <&pro_micro 10 GPIO_ACTIVE_HIGH>
            , <&pro_micro 6 GPIO_ACTIVE_HIGH>
            ;

        row-gpios
            = <&pro_micro 9 (GPIO_ACTIVE_HIGH | GPIO_PULL_DOWN)>
            , <&pro_micro 4 (GPIO_ACTIVE_HIGH | GPIO_PULL_DOWN)>
            , <&pro_micro 20 (GPIO_ACTIVE_HIGH | GPIO_PULL_DOWN)>
            , <&pro_micro 18 (GPIO_ACTIVE_HIGH | GPIO_PULL_DOWN)>
            , <&pro_micro 7 (GPIO_ACTIVE_HIGH | GPIO_PULL_DOWN)>
            ;
            */
    };
};


## config/boards/arm/anisectlc/Kconfig.board
```kconfig
# nrfmicro board configuration

# Copyright (c) 2020 The ZMK Contributors
# SPDX-License-Identifier: MIT

config BOARD_ANISECTLC_10
	bool "anisectlc_10"
	depends on SOC_NRF52840_QIAA
```

## config/boards/arm/anisectlp/Kconfig.board
```kconfig
# nrfmicro board configuration

# Copyright (c) 2020 The ZMK Contributors
# SPDX-License-Identifier: MIT

config BOARD_ANISECTLP_01
	bool "anisectlp_01"
	depends on SOC_NRF52840_QIAA
```

## config/boards/shields/anise60b/Kconfig.defconfig
```kconfig
# Copyright (c) 2020 The ZMK Contributors
# SPDX-License-Identifier: MIT
 
 
if SHIELD_ANISE60B_LEFT

config ZMK_KEYBOARD_NAME
	default "ANISE60B-D"

config ZMK_SPLIT_ROLE_CENTRAL
	default y

endif

if SHIELD_ANISE60B_LEFT || SHIELD_ANISE60B_RIGHT

config ZMK_SPLIT
	default y

endif
```

## config/boards/shields/anise60b/Kconfig.shield
```kconfig
# Copyright (c) 2020 The ZMK Contributors
# SPDX-License-Identifier: MIT

config SHIELD_ANISE60B_LEFT
	def_bool $(shields_list_contains,anise60b_left)

config SHIELD_ANISE60B_RIGHT
	def_bool $(shields_list_contains,anise60b_right)
```

## config/boards/shields/anise60bn/Kconfig.defconfig
```kconfig
# Copyright (c) 2020 The ZMK Contributors
# SPDX-License-Identifier: MIT
 
 
if SHIELD_ANISE60BN_LEFT

config ZMK_KEYBOARD_NAME
	default "ANISE60BN-D"

config ZMK_SPLIT_ROLE_CENTRAL
	default y

endif

if SHIELD_ANISE60BN_LEFT || SHIELD_ANISE60BN_RIGHT

config ZMK_SPLIT
	default y

endif
```

## config/boards/shields/anise60bn/Kconfig.shield
```kconfig
# Copyright (c) 2020 The ZMK Contributors
# SPDX-License-Identifier: MIT

config SHIELD_ANISE60BN_LEFT
	def_bool $(shields_list_contains,anise60bn_left)

config SHIELD_ANISE60BN_RIGHT
	def_bool $(shields_list_contains,anise60bn_right)
```

## config/boards/shields/anise85a/Kconfig.defconfig
```kconfig
# Copyright (c) 2020 The ZMK Contributors
# SPDX-License-Identifier: MIT
 
 
if SHIELD_ANISE85A_LEFT

config ZMK_KEYBOARD_NAME
	default "ANISE85A"

config ZMK_SPLIT_ROLE_CENTRAL
	default y

endif

if SHIELD_ANISE85A_LEFT || SHIELD_ANISE85A_RIGHT

config ZMK_SPLIT
	default y

endif
```

## config/boards/shields/anise85a/Kconfig.shield
```kconfig
# Copyright (c) 2020 The ZMK Contributors
# SPDX-License-Identifier: MIT

config SHIELD_ANISE85A_LEFT
	def_bool $(shields_list_contains,anise85a_left)

config SHIELD_ANISE85A_RIGHT
	def_bool $(shields_list_contains,anise85a_right)
```

## config/boards/shields/quefrency/Kconfig.defconfig
```kconfig
# Copyright (c) 2020 The ZMK Contributors
# SPDX-License-Identifier: MIT
 
 
if SHIELD_QUEFRENCY_LEFT

config ZMK_KEYBOARD_NAME
	default "SPSQ-BOA60D"

config ZMK_SPLIT_ROLE_CENTRAL
	default y

endif

if SHIELD_QUEFRENCY_LEFT || SHIELD_QUEFRENCY_RIGHT

config ZMK_SPLIT
	default y

endif
```
